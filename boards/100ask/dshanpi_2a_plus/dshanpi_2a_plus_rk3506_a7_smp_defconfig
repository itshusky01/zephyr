## dts/bindings/usb/rockchip,rk3506-usb.yaml
```yaml
# Copyright (c) 2026 Jiaming Zhao
# SPDX-License-Identifier: Apache-2.0

description: Rockchip RK3506 DWC2 USB 2.0 OTG controller

compatible: "rockchip,rk3506-usb"

include: ["snps,dwc2.yaml", reset-device.yaml]

properties:
  clocks:
    required: true

  clock-names:
    required: true

  phy-names:
    type: string-array
    required: true

  rockchip,phy-port:
    type: int
    default: 0
    enum: [0, 1]
    description: USB2 PHY port index connected to this controller.
```

## dts/bindings/usb/rockchip,rk3506-usb2phy.yaml
```yaml
# Copyright (c) 2026 Jiaming Zhao
# SPDX-License-Identifier: Apache-2.0

description: Rockchip RK3506 Innosilicon USB 2.0 PHY

compatible: "rockchip,rk3506-usb2phy"

include: [base.yaml, reset-device.yaml]

properties:
  reg:
    required: true

  clocks:
    required: true

  clock-names:
    required: true

  "#clock-cells":
    type: int
    const: 0

child-binding:
  properties:
    "#phy-cells":
      type: int
      const: 0

    status:
      type: string
```

## dts/bindings/watchdog/rockchip,rk3506-wdt.yaml
```yaml
# Copyright (c) 2026 Jiaming Zhao
# SPDX-License-Identifier: Apache-2.0

description: Rockchip RK3506 DesignWare watchdog

compatible: "rockchip,rk3506-wdt"

include: [base.yaml, reset-device.yaml]

properties:
  reg:
    required: true

  interrupts:
    type: array

  clocks:
    type: phandle-array
    required: true

  clock-names:
    type: string-array
    required: true
    const: ["tclk", "pclk"]

  resets:
    type: phandle-array
    required: true

  reset-names:
    type: string-array
    required: true
    const: ["pclk", "tclk"]

  reset-pulse-length:
    type: int
    default: 16
    enum:
      - 2
      - 4
      - 8
      - 16
      - 32
      - 64
      - 128
      - 256

  rockchip,cru:
    type: phandle
    required: true
    description: |
      Phandle to the RK3506 Clock and Reset Unit containing the global
      watchdog reset controls.

  rockchip,wdt-index:
    type: int
    required: true
    enum:
      - 0
      - 1
```

## soc/rockchip/rk35/rk3506/Kconfig
```kconfig
# Copyright (c) 2026 Jiaming Zhao
# SPDX-License-Identifier: Apache-2.0

config SOC_RK3506_A7
	select ARM
	select CPU_CORTEX_A7
	select ARM_ARCH_TIMER
	select ARM_AARCH32_MMU
	select ARM_MMU_MAP_VECTORS
	select SYS_CLOCK_EXISTS
	select SOC_RESET_HOOK
	select KERNEL_DIRECT_MAP

config RK3506_M0
	bool "Rockchip RK3506 Cortex-M0 control"
	default y
	depends on SOC_RK3506_A7
	depends on DT_HAS_ROCKCHIP_RK3506_M0_ENABLED
	select CRC
	help
	  Enable the RK3506 BUSMCU0 control interface, including firmware
	  container validation, SRAM loading, SIP startup, hot restart, and
	  M0 status reporting.

config SOC_PART_NUMBER
	default "RK3506" if SOC_RK3506
```
