## boards/100ask/dshanpi_2a_plus/dshanpi_2a_plus_rk3506_a7_smp_defconfig
```kconfig
# Copyright (c) 2026 Jiaming Zhao
# SPDX-License-Identifier: Apache-2.0

CONFIG_XIP=n
CONFIG_USE_SWITCH=y
CONFIG_RESET=y
CONFIG_CLOCK_CONTROL=y

CONFIG_GPIO=y
CONFIG_PINCTRL=y

CONFIG_SERIAL=y
CONFIG_CONSOLE=y
CONFIG_UART_CONSOLE=y

CONFIG_SMP=y
CONFIG_MP_MAX_NUM_CPUS=3
CONFIG_PM_CPU_OPS=y
CONFIG_PM_CPU_OPS_PSCI=y

CONFIG_KERNEL_VM_SIZE=0x1f000000

CONFIG_ARM_MMU_NUM_L2_TABLES=1024
```

## drivers/clock_control/Kconfig.rockchip
```kconfig
# SPDX-FileCopyrightText: Copyright (c) 2026 KylinSoft Corporation
# SPDX-License-Identifier: Apache-2.0

config CLOCK_CONTROL_ROCKCHIP_RK3506
	bool "Rockchip RK3506 CRU clock controller"
	default y
	depends on DT_HAS_ROCKCHIP_RK3506_CRU_CLK_ENABLED
	help
	  Enable clock gate, rate, parent selection and divider support for the
	  Rockchip RK3506 CRU. DDR clock changes are not supported.

config CLOCK_CONTROL_ROCKCHIP_RK3506_RUNTIME_PLL
	bool "Rockchip RK3506 runtime V0PLL control"
	default n
	depends on CLOCK_CONTROL_ROCKCHIP_RK3506
	help
	  Enable runtime retuning of V0PLL using a fixed set of validated
	  frequencies. This is intended for board-specific DVFS and validation
	  paths, not as a general-purpose PLL synthesis interface.

config CLOCK_CONTROL_ROCKCHIP_RK3588
	bool "Rockchip RK3588 CRU clock controller"
	default y
	depends on DT_HAS_ROCKCHIP_RK3588_CRU_CLK_ENABLED
	help
	  Enable clock gate control for the Rockchip RK3588 CRU.
```

## drivers/gpio/Kconfig.rockchip
```kconfig
# Copyright (c) 2026 Jiaming Zhao
# SPDX-License-Identifier: Apache-2.0

config GPIO_ROCKCHIP
	bool "Rockchip GPIO bank driver"
	default y
	depends on DT_HAS_ROCKCHIP_GPIO_BANK_ENABLED
	help
	  Enable the common Rockchip GPIO bank driver. The driver supports
	  the legacy and split-register GPIO layouts, interrupts, and basic
	  input/output operations. SoC-specific bank quirks are selected
	  through devicetree properties. The split-register layout is
	  currently validated on RK3506.
```

## drivers/hwinfo/Kconfig.rockchip
```kconfig
# Copyright (c) 2026 Jiaming Zhao
# SPDX-License-Identifier: Apache-2.0

config HWINFO_RK3506
	bool "Rockchip RK3506 reset cause"
	default y
	depends on HWINFO
	depends on SOC_RK3506
	depends on DT_HAS_ROCKCHIP_RK3506_RESET_REASON_ENABLED
	select HWINFO_HAS_DRIVER
	help
	  Decode reset causes from the RK3506 PMU reset status register and,
	  when a board selects it in devicetree, an optional persistent scratch
	  marker maintained by the boot firmware.
```

## drivers/mbox/Kconfig.rockchip
```kconfig
# Copyright (c) 2026 Jiaming Zhao
# SPDX-License-Identifier: Apache-2.0

config MBOX_ROCKCHIP_RK3506
	bool "Rockchip RK3506 mailbox"
	default y
	depends on DT_HAS_ROCKCHIP_RK3506_MAILBOX_ENABLED
	depends on CLOCK_CONTROL
	help
	  Enable the Rockchip RK3506 mailbox channel driver. Each 4 KiB mailbox
	  channel provides one 32-bit command word and one 32-bit data word in each
	  direction, with TX-done and RX-done interrupts.
```

## drivers/pinctrl/Kconfig.rockchip
```kconfig
# Copyright (c) 2026 Jiaming Zhao
# SPDX-License-Identifier: Apache-2.0

config PINCTRL_ROCKCHIP_RK3506
	bool "Rockchip RK3506 pinctrl driver"
	default y
	depends on DT_HAS_ROCKCHIP_RK3506_PINCTRL_ENABLED
	help
	  Enable the Rockchip RK3506 pin controller driver. It supports
	  pin mux selection, bias, drive strength, schmitt trigger, input
	  enable, open drain, and slew-rate configuration.
```

## drivers/reset/Kconfig.rockchip
```kconfig
# SPDX-FileCopyrightText: Copyright (c) 2026 KylinSoft Corporation
# SPDX-License-Identifier: Apache-2.0

config RESET_ROCKCHIP_RK3506
	bool "Rockchip RK3506 CRU reset controller"
	default y
	depends on DT_HAS_ROCKCHIP_RK3506_CRU_RST_ENABLED
	help
	  Enable reset control for the Rockchip RK3506 CRU.

config RESET_ROCKCHIP_RK3588
	bool "Rockchip RK3588 CRU reset controller"
	default y
	depends on DT_HAS_ROCKCHIP_RK3588_CRU_RST_ENABLED
	help
	  Enable reset control for the Rockchip RK3588 CRU.
```

## drivers/sdhc/Kconfig.rockchip
```kconfig
# Copyright (c) 2026 Jiaming Zhao
# SPDX-License-Identifier: Apache-2.0

config SDHC_ROCKCHIP_RK3506
	bool "Rockchip RK3506 DesignWare Mobile Storage Host Controller"
	default y
	depends on DT_HAS_ROCKCHIP_RK3506_DW_MSHC_ENABLED
	select SDHC_COMMON
	select SDHC_SUPPORTS_NATIVE_MODE
	select PINCTRL
	select CLOCK_CONTROL
	select RESET
	help
	  Enable the DesignWare Mobile Storage Host Controller driver used by
	  Rockchip RK3506. The driver supports native SD/eMMC commands using
	  PIO/FIFO and internal DMA data transfers, reset/recovery handling,
	  and legacy/high-speed timing. Tuning and HS200/HS400 are not yet
	  implemented.

config SDHC_ROCKCHIP_RK3506_DMA
	bool "Use RK3506 SDHC internal DMA for aligned transfers"
	default n
	depends on SDHC_ROCKCHIP_RK3506
	select CACHE_MANAGEMENT if DCACHE
	help
	  Use the DesignWare internal DMA controller for aligned transfers using
	  chained descriptors. Transfers larger than the configured descriptor
	  span continue to use the PIO/FIFO path.

config SDHC_BUFFER_ALIGNMENT
	default DCACHE_LINE_SIZE if DCACHE
	default 32

config SDHC_ROCKCHIP_RK3506_DMA_MAX_DESC
	int "Maximum RK3506 SDHC IDMAC descriptor count"
	depends on SDHC_ROCKCHIP_RK3506_DMA
	default 256
	range 16 1024
	help
	  Maximum number of chained 32-bit IDMAC descriptors allocated by the
	  driver. Each descriptor transfers up to 4096 bytes, so the default of
	  256 descriptors supports DMA requests up to 1 MiB.

config SDHC_ROCKCHIP_RK3506_CLOCK_LOW_POWER
	bool "Gate the RK3506 SDHC card clock while idle"
	depends on SDHC_ROCKCHIP_RK3506
	default y
	help
	  Enable the controller's cclk_low_power bit. Disable it to keep the card
	  clock running continuously, which can help isolate clock-gating effects
	  during transfer throughput testing.
```

## drivers/sensor/rockchip/Kconfig
```kconfig
# Copyright (c) 2026 Jiaming Zhao
# SPDX-License-Identifier: Apache-2.0

config ROCKCHIP_RK3506_TSADC
	bool "Rockchip RK3506 TSADC"
	default y
	depends on DT_HAS_ROCKCHIP_RK3506_TSADC_ENABLED
	depends on SENSOR
	help
	  Enable the RK3506 on-die temperature sensor driver.
```

## drivers/watchdog/Kconfig.rockchip
```kconfig
# Copyright (c) 2026 Jiaming Zhao
# SPDX-License-Identifier: Apache-2.0

config WDT_RK3506
	bool "Rockchip RK3506 watchdog"
	default y
	depends on DT_HAS_ROCKCHIP_RK3506_WDT_ENABLED
	select CLOCK_CONTROL
	select HAS_WDT_NO_CALLBACKS
	select RESET
	help
	  Enable the RK3506 DesignWare watchdog timer. The driver enables the
	  timer and peripheral clocks, supports reset-only operation, and can
	  disable the watchdog by resetting the WDT controller.
```

## dts/bindings/clock/rockchip,rk3506-cru-clk.yaml
```yaml
# Copyright (c) 2026 Jiaming Zhao
# SPDX-License-Identifier: Apache-2.0

title: Rockchip RK3506 CRU Clock Controller

description: |
  Clock gate controller for the Rockchip RK3506 CRU. Clock IDs are defined
  in include/zephyr/dt-bindings/clock/rk3506-cru.h.

compatible: "rockchip,rk3506-cru-clk"

include: [clock-controller.yaml, base.yaml]

properties:
  "#clock-cells":
    const: 1

clock-cells:
  - clkid
```

## dts/bindings/clock/rockchip,rk3506-cru.yaml
```yaml
# Copyright (c) 2026 Jiaming Zhao
# SPDX-License-Identifier: Apache-2.0

title: Rockchip RK3506 CRU

description: |
  Rockchip RK3506 Clock and Reset Unit (CRU) register block. Child nodes
  provide the clock and reset controller interfaces.

compatible: "rockchip,rk3506-cru"

include: base.yaml

properties:
  reg:
    required: true

child-binding:
  description: |
    Child clock or reset controller nodes sharing the CRU register block.
```

## dts/bindings/gpio/rockchip,gpio-bank.yaml
```yaml
# Copyright (c) 2026 Jiaming Zhao
# SPDX-License-Identifier: Apache-2.0

title: Rockchip GPIO bank

description: Rockchip GPIO bank

compatible: "rockchip,gpio-bank"

include: [gpio-controller.yaml, base.yaml, pinctrl-device.yaml, interrupt-controller.yaml]

properties:
  reg:
    required: true

  rockchip,bank4-pin-remap:
    type: boolean
    description: |
      Swap adjacent pin positions for pins 0 through 5 of this bank. This is
      an RK3506 GPIO bank 4 hardware quirk; the DT node names the affected
      bank directly instead of requiring the generic driver to know its index.

  interrupts:
    type: array
    required: true

  "#gpio-cells":
    const: 2

gpio-cells:
  - pin
  - flags
```

## dts/bindings/hwinfo/rockchip,rk3506-reset-reason.yaml
```yaml
# Copyright (c) 2026 Jiaming Zhao
# SPDX-License-Identifier: Apache-2.0

description: Rockchip RK3506 persistent reset reason scratch

compatible: "rockchip,rk3506-reset-reason"

include: [base.yaml]

properties:
  rockchip,pmugrf:
    type: phandle
    required: true

  rockchip,status-offset:
    type: int
    required: true

  rockchip,clear-offset:
    type: int
    required: true

  rockchip,scratch-offset:
    type: int
    required: true

  rockchip,scratch-magic:
    type: int
    required: true
```

## dts/bindings/ipc/zephyr,ipc-openamp-static-vrings.yaml
```yaml
# Copyright (c) 2021 Carlo Caione <ccaione@baylibre.com>
# SPDX-License-Identifier: Apache-2.0

description: OpenAMP (RPMsg with static VRINGs) backend

compatible: "zephyr,ipc-openamp-static-vrings"

include: base.yaml

properties:
  role:
    description: OpenAMP roles
    required: true
    type: string
    enum:
      - host
      - remote

  memory-region:
    description: phandle to the shared memory region
    required: true
    type: phandle

  mboxes:
    description: phandle to the MBOX controller (TX and RX are required)
    required: true

  mbox-names:
    description: MBOX channel names (must be called "tx" and "rx")
    required: true

  zephyr,priority:
    type: array
    description: |
      WQ priority for the instance. This property is an array composed by the
      priority level and the type of priority (PRIO_COOP for cooperative or
      PRIO_PREEMPT for preemptive).

      For example for a thread priority K_PRIO_COOP(1) in DT we have
        priority = <1 PRIO_COOP>;
      or for K_PRIO_PREEMPT(2)
        priority = <2 PRIO_PREEMPT>;

      When this property is missing a default priority of <0 PRIO_PREEMPT> is
      assumed.

  zephyr,buffer-size:
    type: int
    description: |
      The size of the buffer used to send data between host and remote. Default
      value is RPMSG_BUFFER_SIZE. This property must be the same for host and
      remote and preferably a multiple of the cache line size.

  zephyr,tx-vring-offset:
    type: int
    description: |
      Offset of the TX vring from the start of the memory-region. When this
      property is present, all fixed-layout properties must be provided and
      the backend uses the explicit layout instead of deriving one from the
      region size.

  zephyr,rx-vring-offset:
    type: int
    description: |
      Offset of the RX vring from the start of the memory-region.

  zephyr,buffer-pool-offset:
    type: int
    description: |
      Offset of the RPMsg buffer pool from the start of the memory-region.

  zephyr,buffer-pool-size:
    type: int
    description: |
      Size of the RPMsg buffer pool in bytes.

  zephyr,num-descriptors:
    type: int
    description: |
      Number of descriptors in each fixed-layout vring. The value must be a
      power of two representable by uint16_t.
```

## dts/bindings/mbox/rockchip,rk3506-mailbox.yaml
```yaml
# Copyright (c) 2026 Jiaming Zhao
# SPDX-License-Identifier: Apache-2.0

description: Rockchip RK3506 mailbox channel

compatible: "rockchip,rk3506-mailbox"

include: [base.yaml, mailbox-controller.yaml]

properties:
  reg:
    required: true

  interrupts:
    required: true

  clocks:
    required: true

  clock-names:
    required: true
    const: ["pclk_mailbox"]

  "#mbox-cells":
    const: 0
```

## dts/bindings/misc/rockchip,rk3506-m0.yaml
```yaml
# Copyright (c) 2026 Jiaming Zhao
# SPDX-License-Identifier: Apache-2.0

description: Rockchip RK3506 BUSMCU0 remote core

compatible: "rockchip,rk3506-m0"

include: base.yaml

properties:
  memory-region:
    type: phandle
    description: Shared DDR region used by the M0 runtime and A7 IPC
```

## dts/bindings/pinctrl/rockchip,rk3506-pinctrl.yaml
```yaml
# Copyright (c) 2026 Jiaming Zhao
# SPDX-License-Identifier: Apache-2.0

title: Rockchip RK3506 pin controller

description: |
  Pin controller for the Rockchip RK3506 IOC/GRF blocks. Pin configurations
  use a 32-bit encoded value containing bank, pin, and mux function.

compatible: "rockchip,rk3506-pinctrl"

include: base.yaml

properties:
  rockchip,grf:
    type: phandle
    required: true
  rockchip,ioc1:
    type: phandle
    required: true
  rockchip,pmu:
    type: phandle
    required: true

child-binding:
  description: |
    A pin control state. State nodes contain one or more pin groups.

  child-binding:
    include:
      - name: pincfg-node.yaml
        property-allowlist:
          - bias-disable
          - bias-pull-up
          - bias-pull-down
          - drive-strength
          - drive-open-drain
          - drive-push-pull
          - input-enable
          - input-disable
          - input-schmitt-enable
          - input-schmitt-disable
          - slew-rate

    properties:
      pinmux:
        type: array
        required: true
        description: |
          Array of encoded RK3506 pin mux entries. Use
          RK3506_PINCTRL_MUX(bank, pin, function) from
          zephyr/dt-bindings/pinctrl/rk3506-pinctrl.h.
```

## dts/bindings/reset/rockchip,rk3506-cru-rst.yaml
```yaml
# Copyright (c) 2026 Jiaming Zhao
# SPDX-License-Identifier: Apache-2.0

title: Rockchip RK3506 CRU Reset Controller

description: |
  Reset controller for the Rockchip RK3506 CRU. Reset IDs are defined in
  include/zephyr/dt-bindings/reset/rk3506-cru-reset.h.

compatible: "rockchip,rk3506-cru-rst"

include: [reset-controller.yaml, base.yaml]

properties:
  "#reset-cells":
    const: 1

reset-cells:
  - id
```

## dts/bindings/sdhc/rockchip,rk3506-dw-mshc.yaml
```yaml
# Copyright (c) 2026 Jiaming Zhao
# SPDX-License-Identifier: Apache-2.0

title: Rockchip RK3506 DesignWare Mobile Storage Host Controller

description: Rockchip RK3506 DesignWare Mobile Storage Host Controller

compatible: "rockchip,rk3506-dw-mshc"

include: [sdhc.yaml, pinctrl-device.yaml, reset-device.yaml]

properties:
  clocks:
    required: true

  clock-names:
    required: true
    min-len: 2
    max-len: 2
    const: ["biu", "ciu"]

  resets:
    required: true

  reset-names:
    required: true
    min-len: 1
    max-len: 1
    const: ["reset"]

  pinctrl-0:
    required: true

  pinctrl-names:
    required: true

  fifo-depth:
    type: int
    default: 0
    description: |
      Depth of the controller data FIFO in 32-bit words. A value of zero
      detects the depth from the reset value of the FIFO threshold register.

  non-removable:
    type: boolean
    description: |
      The attached device is non-removable, such as an eMMC. Card detection
      always reports that a card is present.

  bus-width:
    default: 4
```

## dts/bindings/sensor/rockchip,rk3506-tsadc.yaml
```yaml
# Copyright (c) 2026 Jiaming Zhao
# SPDX-License-Identifier: Apache-2.0

title: Rockchip RK3506 on-die temperature sensor

description: Rockchip RK3506 on-die temperature sensor

compatible: "rockchip,rk3506-tsadc"

include: [sensor-device.yaml, base.yaml]

properties:
  reg:
    required: true

  interrupts:
    required: true

  clocks:
    required: true

  clock-names:
    required: true

  rockchip,grf:
    type: phandle
    required: true
    description: General register file used for TSADC analog configuration.

  rockchip,otp:
    type: phandle
    required: true
    description: OTP controller used to read the TSADC trim value.

  rockchip,hw-tshut-temp:
    type: int
    default: 120000
    description: Hardware thermal shutdown temperature in millidegrees Celsius.
```
